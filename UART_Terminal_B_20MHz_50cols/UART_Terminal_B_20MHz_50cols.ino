// ***************************************************************************
// *****                                                                 *****
// ***** AtMega328P UART ANSI Terminal with 50x30 Character VGA and PS/2 *****
// *****                                                                 *****
// *****        written by Carsten Herting 16.08.2025 Version 2.3        *****
// *****                                                                 *****
// ***************************************************************************
// Set AtMega328P FuseA from 0xFF to 0xBF to output system clock CLKO on PB0
// Pin C0-5: terminal input bits 0-5
// Pin D0-7: parallel pixel output to 74166, in between: D6-7 terminal input bits 6-7
// Pin B0:   CLKO ATmega328 system clock output (program fuse byte to 0xBF)
// Pin B1:   DATA_NEW input handshake
// Pin B2:   /VSYNC VGA (timer1, every 1/60s, could also be done)
// Pin B3:   /PE low pulse (by hand inside ISR for 74166 /PE pixel shift register sync parallel load)
// Pin B4:   /HSYNC VGA (by hand inside ISR, every 32µs)
// Pin B5:   DATA_ACK output handshake
// See license at the end of this file.

#define WIDTH     50              // 20MHz crystal required
#define HEIGHT    30

char row = 0, col = 0;            // current cursor position in terminal window
char hideCursor = 0;              // cursor can be switched off by CSI
volatile int vline = 0;           // current vertical position of pixel video output
volatile byte vram[HEIGHT][WIDTH];// array of VideoRAM
volatile char start = 0;          // start line of the VideoRAM (thus avoiding moving data while scrolling)
volatile int frames = 0;          // 1/60s frame counter for cursor blinking
volatile byte regout = 0;         // index of current output position in queue
volatile byte regin = 0;          // index of current input position in queue
volatile byte reg[256];           // ring buffer data of keyboard input register

const volatile byte __attribute__ ((aligned (256))) charset[8][256] PROGMEM =
{
  0x00,0x00,0x00,0x00,0x00,0x00,0x00,0x00,0x00,0x00,0x00,0x00,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0xFF,
  0x00,0x00,0x00,0x00,0x00,0x00,0x00,0x00,0x00,0x00,0x00,0x00,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0xEF,
  0x00,0x00,0x00,0x00,0x00,0x00,0x00,0x00,0x00,0x00,0x00,0x00,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0xCF,
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  0x00,0x00,0x00,0x00,0x00,0x00,0x00,0x00,0x00,0x00,0x00,0x00,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0xFF,
};

void setup()
{
  noInterrupts();                   // disable interrupts before messing around with timer registers

  DDRC  = 0b00000000;               // PORTC is always input
  PORTC = 0b00000000;
  DDRD  = 0b11111111;               // PORTD is always output
  PORTD = 0b00000000;
  DDRB  = 0b00111100;               // B0-1: terminal input bits 0-1, B2: VSYNC (timer1), B3: 74165 /PL (timer2 or by hand???), B4: HSync by hand inside ISR
  PORTB = 0b00011000;               // HSYNC=1, /PE=1

  GTCCR = 0b10000011;               // set TSM, PSRSYNC und PSRASY to correlate all 3 timers

  // *****************************
  // ***** Timer0: VGA HSYNC *****
  // *****************************
  TCNT0  = 36;                       // align VSYNC and HSYNC pulses
  TCCR0A = (1 << WGM01) | (0 << WGM00);   // mode 2: Clear Timer on Compare Match (CTC)
  TCCR0B = (0 << WGM02) | (0 << CS02) | (1 << CS01) | (0 << CS00); // x8 prescaler -> 0.5µs
  OCR0A  = 79;                      // 60cols (24MHz): 95, 50cols (20MHz): 79, 40cols (16MHz): 63, compare match register A (TOP) -> 32µs
  TIMSK0 = (1 << OCIE0A);           // output Compare Match A Interrupt Enable (not working: TOIE1 with ISR TIMER0_TOIE1_vect because it is already defined by timing functions)

  // *****************************
  // ***** Timer1: VGA VSYNC *****
  // *****************************
  TCNT1  = 0;
  TCCR1A = (1 << COM1B1) | (1 << COM1B0) | (1 << WGM11) | (1 << WGM10); // mode 15 (Fast PWM), set OC1B on Compare Match, clear OC1B at BOTTOM, controlling OC1B pin 10
  TCCR1B = (1 << WGM13) | (1 << WGM12) | (1 << CS12) | (0 << CS11) | (1 << CS10); // x 1024 prescaler -> 64µs
  OCR1A  = 324;                     // 60cols (24MHz): 389, 50cols (20MHz): 324, 40cols (16MHz): 259, compare match register A (TOP) -> 16.64ms
  OCR1B  = 0;                       // compare match register B -> 64µs
  TIMSK1 = (1 << TOIE1);            // enable timer overflow interrupt setting vlines = 0

  // ************************************************
  // ***** Timer2: only used for jitter control *****
  // ************************************************
  TCNT2  = 0;
  TCCR2A = (0<<COM2A1) | (0<<COM2A0) | (1<<WGM21) | (1<<WGM20); // mode 7: Fast PWM, COM2A0=0: normal port HIGH, COM2A0=1: Toggle OC2A pin 11 on Compare Match
  TCCR2B = (1<<WGM22) | (0<<CS22) | (0<<CS21) | (1<<CS20) ;     // set x0 prescaler -> 62.5ns;
  OCR2A  = 7;                       // compare match register A (TOP) -> 250ns
  TIMSK2 = 0;                       // no interrupts here

  GTCCR = 0;                        // clear TSM => all timers start synchronously
  interrupts();

  UCSR0B = 0;                       // brute-force the USART off just in case...

  for (int j=0; j<HEIGHT; j++) for (int i=0; i<WIDTH; i++) vram[j][i] = ' ';
}

void loop()
{  
  if ((frames & 63) == 32 && col < WIDTH && hideCursor == 0) vram[row][col] |= 0b10000000;
  else if ((frames & 63) == 0 && col < WIDTH) vram[row][col] &= 0b01111111;

  if (regout != regin)                            // was a character received
  {
    if (col < WIDTH) vram[row][col] &= 0b01111111; // restore character beneath the cursor BEFORE a possible scrolling happens
    do ProcessChar(reg[regout++]); while (regout != regin); // process the character
  }
}

int main() { setup(); while (true) loop(); }      // enforce main() loop w/o serial handler

ISR(TIMER1_OVF_vect) { vline = 0; frames++; }     // timer1 overflow interrupt resets vline at HSYNC

// *****************************************************************
// *****                                                       *****
// ***** ANSI Terminal Implementation (add new functions here) *****
// *****                                                       *****
// *****************************************************************
void ProcessChar(byte inbyte)                     // processes a character (accepts some VT52/GEMDOS ESC sequences, control chars, normal chars)
{
  static char escvalid = -2;                      // number of valid characters in escbuffer[], -2: no ESC received, -1: ESC received, 0: ESC [ received
  static byte escbuffer[3] = { 0, 0, 0 };
  
  frames = 30;                                    // hide cursor for a brief time after receiving a character

  if (inbyte == 27) { escvalid = -1; return; }    // ESC character always starts a new escape sequence

  switch (escvalid)
  {
    case -2: // process inbyte as normal character
    {
      switch (inbyte)
      {
        case '\r': col = 0; break;                 // process 'carriage return'
        case '\n':                                 // process 'newline'
        {        
          col = 0;
          if (row < HEIGHT-1) row++; else row=0;
          if (row == start)
          {
            for (int i=0; i<WIDTH; i++) vram[row][i] = ' ';
            start++; if (start > HEIGHT-1) start = 0;
          }
          break;
        }        
        case 8:                                    // process 'BACKSPACE'
        {
          if (col > 0) vram[row][--col] = 32; 
          else if (row != start) { if (row > 0) row--; else row = HEIGHT-1; vram[row][WIDTH-1] = 32; col = WIDTH-1; }
          break;
        }        
        default:                                   // process all other characters
        {
          if (inbyte >= 32)                        // start of printable characters
          {
            if (col > WIDTH-1)
            {
              col = 0;
              if (row < HEIGHT-1) row++; else row=0;
              for (int i=0; i<WIDTH; i++) vram[row][i] = ' ';
              if (row == start) { start++; if (start > HEIGHT-1) start = 0; }
            }
            vram[row][col++] = inbyte; // output char to terminal screen
          }
          break;
        }
      }
      break;
    }    
    case -1: // process inbyte after ESC => wait for [ character
    {
      if (inbyte == '[') escvalid = 0; else escvalid = -2; // als 2. Zeichen MUSS '[' kommen
      break;
    }
    case 0: case 1: case 2: case 3: // process inbyte as part of ESC [ ... sequence (escvalid = number of received characters after ESC [)
    {    
      switch (inbyte) // check for closing character of ESC sequence
      {
        case 'l': // ESC [?25l (hide cursor)
        {
          if (escvalid > 2 && escbuffer[0] == '?' && escbuffer[1] == '2' && escbuffer[2] == '5') hideCursor = 1;
          escvalid = -2; break;
        }
        case 'h': // ESC [?25h (show cursor)
        {
          if (escvalid > 2 && escbuffer[0] == '?' && escbuffer[1] == '2' && escbuffer[2] == '5') hideCursor = 0;
          escvalid = -2; break;
        }
        case 'S': // scroll up
        {
          for (int i=0; i<WIDTH; i++) vram[start][i] = ' ';
          start++; if (start > HEIGHT-1) start = 0;
          row++; if (row > HEIGHT-1) row = 0;
          escvalid = -2; break;
        }
        case 'T': // scroll down
        {
          start--; if (start < 0) start = HEIGHT-1;
          row--; if (row < 0) row = HEIGHT-1;
          for (int i=0; i<WIDTH; i++) vram[start][i] = ' ';
          escvalid = -2; break;
        }
        case 'A': // move cursor up
        {
          byte anz = 1;
          if (escvalid > 1) { anz = (escbuffer[0] - 48) << 1; anz += (anz << 2) + escbuffer[1] - 48; }
          else if (escvalid == 1) anz = escbuffer[0] - 48;
          for (byte i = 0; i < anz; i++) if (row != start) { row--; if (row < 0) row = HEIGHT-1; }
          escvalid = -2; break;
        }
        case 'B': // move cursor down
        {
          byte anz = 1;
          if (escvalid > 1) { anz = (escbuffer[0] - 48) << 1; anz += (anz << 2) + escbuffer[1] - 48; }
          else if (escvalid == 1) anz = escbuffer[0] - 48;
          for (byte i = 0; i < anz; i++) { byte oldrow = row; row++; if (row > HEIGHT-1) row = 0; if (row == start) row = oldrow; }
          escvalid = -2; break;
        }
        case 'C': // move cursor right
        {
          byte anz = 1;
          if (escvalid > 1) { anz = (escbuffer[0] - 48) << 1; anz += (anz << 2) + escbuffer[1] - 48; }
          else if (escvalid == 1) anz = escbuffer[0] - 48;
          for (byte i = 0; i < anz; i++) if (col < WIDTH-1) col++;
          escvalid = -2; break;
        }
        case 'D': // move cursor left
        {
          byte anz = 1;
          if (escvalid > 1) { anz = (escbuffer[0] - 48) << 1; anz += (anz << 2) + escbuffer[1] - 48; }
          else if (escvalid == 1) anz = escbuffer[0] - 48;
          for (byte i = 0; i < anz; i++) if (col > 0) col--;
          escvalid = -2; break;
        }
        case 'G': // move cursor to an absolute x position (left border: 1)
        {
          byte anz;
          if (escvalid > 1) { anz = (escbuffer[0] - 48) << 1; col = min(WIDTH-1, max(0, (anz << 2) + anz + escbuffer[1] - 48 - 1)); }
          else if (escvalid == 1) { col = min(WIDTH-1, max(0, escbuffer[0] - 48 - 1)); }
          else col = 0;
          escvalid = -2; break;
        }
        case 'd': // move cursor to an absolute x position (left border: 1)
        {
          byte anz;
          if (escvalid > 1)
          {
            anz = (escbuffer[0] - 48) << 1;
            row = start + min(HEIGHT-1, max(0, (anz << 2) + anz + escbuffer[1] - 48 - 1));
            if (row > HEIGHT-1) row -=HEIGHT;
          }
          else if (escvalid == 1)
          {
            row = start + min(HEIGHT-1, max(0, escbuffer[0] - 48 - 1));
            if (row > HEIGHT-1) row -=HEIGHT;
          }
          else row = start;
          escvalid = -2; break;
        }
        case 'H': // move cursor to upper left corner
        {
          row = start; col = 0;
          escvalid = -2; break;
        }        
        case 'J': // clear VRAM from cursor onwards
        {
          for (int i=col; i<WIDTH; i++) vram[row][i] = ' ';
          byte r = row;
          do
          {
            if (++r > HEIGHT-1) r = 0;
            for (int i=0; i<WIDTH; i++) vram[r][i] = ' ';
          } while (r != start);
          escvalid = -2; break;
        }
        case 'K': // clear line from cursor onwards (does not move the cursor)
        {        
          for (int i=col; i<WIDTH; i++) vram[row][i] = ' ';
          escvalid = -2; break;
        }        
        case '?':  // not 'end of sequence' character => append char to ESC sequence
        case '0': case '1': case '2': case '3': case '4':
        case '5': case '6': case '7': case '8': case '9':
        {
          escbuffer[escvalid++] = inbyte; break;
        }
        default: escvalid = -2; break; // all other chars discard ESC sequence
      }
      break;
    }
    default: escvalid = -2; break; // ESC [ ... is too long! => discard sequence
  }
}

/*
  -----------
  MIT License
  -----------
  Copyright (c) 2025, 2026 Carsten Herting (slu4)
  Permission is hereby granted, free of charge, to any person obtaining a copy of
  this software and associated documentation files (the "Software"), to deal in
  the Software without restriction, including without limitation the rights to
  use, copy, modify, merge, publish, distribute, sublicense, and/or sell copies
  of the Software, and to permit persons to whom the Software is furnished to do
  so, subject to the following conditions:
  The above copyright notice and this permission notice shall be included in all
  copies or substantial portions of the Software.
  THE SOFTWARE IS PROVIDED "AS IS", WITHOUT WARRANTY OF ANY KIND, EXPRESS OR
  IMPLIED, INCLUDING BUT NOT LIMITED TO THE WARRANTIES OF MERCHANTABILITY,
  FITNESS FOR A PARTICULAR PURPOSE AND NONINFRINGEMENT. IN NO EVENT SHALL THE
  AUTHORS OR COPYRIGHT HOLDERS BE LIABLE FOR ANY CLAIM, DAMAGES OR OTHER
  LIABILITY, WHETHER IN AN ACTION OF CONTRACT, TORT OR OTHERWISE, ARISING FROM,
  OUT OF OR IN CONNECTION WITH THE SOFTWARE OR THE USE OR OTHER DEALINGS IN THE
  SOFTWARE.
*/
